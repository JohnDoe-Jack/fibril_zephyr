## CMakeLists.txt
```
cmake_minimum_required(VERSION 3.20.0)
find_package(Zephyr REQUIRED HINTS $ENV{ZEPHYR_BASE})
project(esp_now_gamepad_bridge_sample)
target_sources(app PRIVATE src/main.c)
```

## sample.yaml
```
sample:
  name: ESP-NOW gamepad UART receiver
common:
  build_only: true
  integration_platforms:
    - waveshare_rp2350_can/rp2350a/m33
  tags: [gamepad, uart]
tests:
  sample.esp_now_gamepad_bridge: {}
```

## prj.conf
```kconfig
CONFIG_SERIAL=y
CONFIG_COBS=y
CONFIG_ESP_NOW_GAMEPAD_BRIDGE=y
CONFIG_LOG=y
CONFIG_UART_CONSOLE=n
CONFIG_SHELL_BACKEND_SERIAL=n
```

## boards/waveshare_rp2350_can_rp2350a_m33.conf
```kconfig
# PL011 in Zephyr v4.4.1 has interrupt-driven RX, not the async API.
CONFIG_ESP_NOW_GAMEPAD_BRIDGE_INTERRUPT=y
CONFIG_LOG_BACKEND_UART=n
CONFIG_LOG_BACKEND_RTT=y
```

## boards/waveshare_rp2350_can_rp2350a_m33.overlay
```dts
/ {
	aliases {
		gamepad-uart = &uart0;
	};
};

&uart0 {
	/* ESP32-C3 GPIO21 TX connects to GP1 RX; no UART TX wiring is needed. */
	current-speed = <115200>;
	/delete-property/ hw-flow-control;
	status = "okay";
};
```

## src/main.c
```c
/* SPDX-License-Identifier: Apache-2.0 */
#include <zephyr/kernel.h>
#include <zephyr/logging/log.h>
#include <esp_now_gamepad_bridge/gamepad_bridge.h>

LOG_MODULE_REGISTER(gamepad_sample, LOG_LEVEL_INF);

int main(void)
{
	const struct device *uart = DEVICE_DT_GET(DT_ALIAS(gamepad_uart));
	int ret = gamepad_bridge_init(uart);

	if (ret == 0) {
		ret = gamepad_bridge_start();
	}
	if (ret < 0) {
		LOG_ERR("Gamepad receiver startup failed (%d)", ret);
		return ret;
	}

	while (true) {
		struct gamepad_state state;
		struct gamepad_bridge_stats stats;

		ret = gamepad_bridge_get_state(&state);
		if (ret < 0) {
			return ret;
		}
		ret = gamepad_bridge_get_stats(&stats);
		if (ret < 0) {
			return ret;
		}
		LOG_INF("connected=%u seq=%u buttons=0x%04x L=(%d,%d) R=(%d,%d) LT=%u RT=%u",
			state.connected, state.seq, state.buttons, state.lx, state.ly,
			state.rx, state.ry, state.lt, state.rt);
		LOG_INF("valid=%u duplicate=%u dropped=%u timeout=%u UART errors=%u restarts=%u",
			stats.frames_valid, stats.duplicate_frames, stats.dropped_frames,
			stats.timeouts, stats.uart_errors, stats.rx_restarts);
		k_sleep(K_MSEC(200));
	}
}
```
