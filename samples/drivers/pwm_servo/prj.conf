## CMakeLists.txt
```
cmake_minimum_required(VERSION 3.20.0)
find_package(Zephyr REQUIRED HINTS $ENV{ZEPHYR_BASE})
project(pwm_servo_sample)
target_sources(app PRIVATE src/main.c)
```

## sample.yaml
```
sample:
  name: Generic PWM servo
common:
  build_only: true
  integration_platforms:
    - waveshare_rp2350_can/rp2350a/m33
  tags:
    - servo
    - pwm
tests:
  sample.drivers.pwm_servo: {}
```

## prj.conf
```kconfig
CONFIG_PWM=y
CONFIG_SERVO=y
CONFIG_LOG=y
```

## boards/waveshare_rp2350_can_rp2350a_m33.overlay
```dts
#include <zephyr/dt-bindings/pwm/pwm.h>

/ {
	aliases {
		servo0 = &servo0;
	};

	servo0: servo0 {
		compatible = "fibril,pwm-servo";
		/* GP20 is PWM2A (channel 4); this servo uses a 50 Hz frame. */
		pwms = <&pwm 4 PWM_MSEC(20) PWM_POLARITY_NORMAL>;
		/* Calibration for the intended 500--2500 us, 0--180 degree servo. */
		min-pulse-us = <500>;
		center-pulse-us = <1500>;
		max-pulse-us = <2500>;
		min-angle-deg = <0>;
		max-angle-deg = <180>;
	};
};
```

## src/main.c
```c
/* SPDX-License-Identifier: Apache-2.0 */
#include <zephyr/device.h>
#include <zephyr/kernel.h>
#include <zephyr/logging/log.h>
#include <drivers/servo.h>

LOG_MODULE_REGISTER(servo_sample, LOG_LEVEL_INF);

#define SERVO_NODE DT_ALIAS(servo0)

int main(void)
{
	const struct device *servo = DEVICE_DT_GET(SERVO_NODE);
	const uint32_t pulses[] = {
		DT_PROP(SERVO_NODE, min_pulse_us),
		DT_PROP(SERVO_NODE, center_pulse_us),
		DT_PROP(SERVO_NODE, max_pulse_us),
	};
	int ret;

	if (!device_is_ready(servo)) {
		LOG_ERR("Servo is not ready");
		return -ENODEV;
	}

	/* Allow time to attach measurement equipment before the first movement. */
	k_sleep(K_SECONDS(3));
	for (size_t i = 0; i < ARRAY_SIZE(pulses); i++) {
		LOG_INF("Pulse: %u us", pulses[i]);
		ret = servo_set_pulse(servo, pulses[i]);
		if (ret < 0) {
			goto stop;
		}
		k_sleep(K_SECONDS(2));
	}

	LOG_INF("Angle midpoint");
	ret = servo_set_angle(servo, (float)(((double)(int32_t)DT_PROP(SERVO_NODE, min_angle_deg) +
					    (double)(int32_t)DT_PROP(SERVO_NODE, max_angle_deg)) / 2.0));
	if (ret == 0) {
		k_sleep(K_SECONDS(2));
	}

stop:
	if (ret < 0) {
		LOG_ERR("Servo command failed (%d)", ret);
	}
	int stop_ret = servo_disable(servo);

	if (stop_ret < 0) {
		LOG_ERR("Servo stop failed (%d)", stop_ret);
	} else {
		LOG_INF("Servo output stopped");
	}
	return ret < 0 ? ret : stop_ret;
}
```
