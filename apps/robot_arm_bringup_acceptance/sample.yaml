## apps/robot_arm_bringup_acceptance/sample.yaml
```yaml
sample:
  name: Robot arm hardware acceptance and fault-injection bring-up
common:
  build_only: true
  platform_allow:
    - waveshare_rp2350_can/rp2350a/m33
tests:
  sample.robot_arm_bringup_acceptance: {}
```

## apps/robot_arm_bringup_full/sample.yaml
```yaml
sample:
  name: Full robot arm hardware bring-up
common:
  build_only: true
  platform_allow:
    - waveshare_rp2350_can/rp2350a/m33
tests:
  sample.robot_arm_bringup_full: {}
```

## drivers/can/Kconfig
```kconfig
# SPDX-License-Identifier: Apache-2.0

config CAN_XL2515_SAFE
	bool "Fault-contained XL2515 CAN driver"
	default y
	depends on DT_HAS_FIBRIL_XL2515_SAFE_ENABLED
	select SPI
	help
	  Enable the XL2515 driver with bounded interrupt draining, a
	  preemptible interrupt worker, and delayed controller recovery.

if CAN_XL2515_SAFE

config CAN_XL2515_SAFE_INT_THREAD_STACK_SIZE
	int "XL2515 interrupt worker stack size"
	default 1024

config CAN_XL2515_SAFE_INT_THREAD_PRIO
	int "XL2515 preemptible interrupt worker priority"
	default 2
	help
	  Preemptible priority used by the internal interrupt worker. Keep this
	  numerically greater than the time-critical application control thread.

config CAN_XL2515_SAFE_MAX_FILTERS
	int "Maximum number of concurrent active filters"
	default 16
	range 1 32

config CAN_XL2515_SAFE_IRQ_DRAIN_LIMIT
	int "Maximum interrupt causes handled per wake-up"
	default 32
	range 1 256
	help
	  Bounds the work done after one GPIO interrupt. Reaching the limit is
	  treated as a stuck interrupt and starts controller recovery.

config CAN_XL2515_SAFE_RECOVERY_DELAY_MS
	int "Delay before controller recovery"
	default 100
	range 1 60000
	help
	  Backoff used after SPI, GPIO, stuck-interrupt, or bus-off faults.

endif # CAN_XL2515_SAFE
```

## drivers/motor/Kconfig.robomaster
```kconfig
config MOTOR_DJI_ROBOMASTER
	bool "DJI RoboMaster C610/C620 motor driver"
	default y
	depends on CAN
	depends on DT_HAS_DJI_ROBOMASTER_ENABLED
	help
	  Enable support for DJI RoboMaster C610/C620 motor controllers exposed
	  as one logical motor device per motor.

if MOTOR_DJI_ROBOMASTER

config MOTOR_DJI_ROBOMASTER_TX_STACK_SIZE
	int "RoboMaster transmit worker stack size"
	default 1024
	range 512 8192

config MOTOR_DJI_ROBOMASTER_TX_THREAD_PRIORITY
	int "RoboMaster transmit worker priority"
	default 5
	range -16 15
	help
	  Preemptible worker priority. Keep this lower priority than the application
	  control thread; CAN submission never runs in that control thread.

endif
```

## drivers/motor/Kconfig.robstride
```kconfig
config MOTOR_ROBSTRIDE
	bool "RobStride RS00 motor driver"
	default y
	depends on CAN
	depends on DT_HAS_ROBSTRIDE_CONTROLLER_ENABLED
	help
	  Enable the typed RobStride RS00 extended-CAN driver.

if MOTOR_ROBSTRIDE

config MOTOR_ROBSTRIDE_TX_STACK_SIZE
	int "RobStride transmit worker stack size"
	default 1280
	range 768 8192

config MOTOR_ROBSTRIDE_TX_THREAD_PRIORITY
	int "RobStride transmit worker priority"
	default 5
	range -16 15

endif
```

## drivers/servo/Kconfig
```kconfig
# SPDX-License-Identifier: Apache-2.0
menuconfig SERVO
	bool "Servo driver support"
	depends on PWM
	help
	  Enable generic RC servo drivers using the Zephyr PWM API.

if SERVO

config SERVO_INIT_PRIORITY
	int "Servo driver init priority"
	default 85
	help
	  Must be later than the initialization priority of the PWM controller.

module = SERVO
module-str = servo
source "subsys/logging/Kconfig.template.log_config"

endif # SERVO
```

## dts/bindings/can/fibril,xl2515-safe.yaml
```yaml
# SPDX-License-Identifier: Apache-2.0

description: Fault-contained XL2515 SPI CAN controller

compatible: "fibril,xl2515-safe"

include: [spi-device.yaml, can-controller.yaml]

properties:
  osc-freq:
    type: int
    required: true
    description: Frequency of the external oscillator

  int-gpios:
    type: phandle-array
    required: true
    description: Active-low controller interrupt pin

  reg:
    type: array
    required: true
```

## dts/bindings/motor/dji,robomaster-motor.yaml
```yaml
description: DJI RoboMaster C610/C620 motor node

compatible: "dji,robomaster-motor"

include: base.yaml

on-bus: dji,robomaster

properties:
  reg:
    required: true
    description: Motor ID on the RoboMaster bus, in the range 1..8.
  model:
    type: string
    required: true
    enum:
      - c610
      - c620
    description: Motor controller model.
  max-current:
    type: int
    description: >
      Maximum absolute raw command. For C610, 1000 raw counts represent 1 A.
  rotor-speed-bound-rpm:
    type: int
    default: 10000
    description: >
      Maximum absolute rotor speed used to validate continuous position. The
      maximum feedback gap is floor(30000 / rpm) - 1 milliseconds.
  gear-ratio:
    type: int
    description: Optional motor gear ratio metadata for higher-level control.
```

## dts/bindings/motor/dji,robomaster.yaml
```yaml
description: DJI RoboMaster motor transport

compatible: "dji,robomaster"

include: motor-controller.yaml

properties:
  cans:
    type: phandles
    required: true
    description: >
      One or more CAN controller devices used to talk to RoboMaster motors.
      Motor IDs must be unique within this transport.
  feedback-timeout-ms:
    type: int
    default: 100
    description: >
      Feedback is reported stale when no update has been received within this
      timeout.
  tx-period-us:
    type: int
    default: 1000
    description: Period between latest-wins group command transmissions.
  command-timeout-ms:
    type: int
    default: 0
    description: >
      Maximum age of a newly submitted nonzero command. Zero preserves the
      legacy behavior and disables command expiry.
  external-bus-management:
    type: boolean
    description: >
      Do not start or stop the CAN controller. The application owns the shared
      bus and calls robomaster_transport_start after starting it.
```

## dts/bindings/motor/robstride,controller.yaml
```yaml
description: RobStride motor controller transport

compatible: "robstride,controller"

include: motor-controller.yaml

properties:
  can:
    type: phandle
    required: true
    description: Shared Classic CAN controller.
  master-id:
    type: int
    default: 253
  feedback-timeout-ms:
    type: int
    default: 100
  command-timeout-ms:
    type: int
    default: 100
  external-bus-management:
    type: boolean
    description: The application owns CAN start and stop.
```

## dts/bindings/motor/robstride,rs00.yaml
```yaml
description: RobStride RS00 motor

compatible: "robstride,rs00"

include: base.yaml

on-bus: robstride,controller

properties:
  reg:
    required: true
    description: Motor CAN ID in the range 1 through 127.
```

## dts/bindings/servo/fibril,pwm-servo.yaml
```yaml
# SPDX-License-Identifier: Apache-2.0

description: |
  Generic RC servo controlled by one Zephyr PWM channel. Angle commands are
  mapped linearly between the minimum and maximum pulse widths. The center
  pulse is a calibration reference, not a third interpolation point.
  Initialization holds the output inactive until the first command.

compatible: "fibril,pwm-servo"
include: base.yaml

properties:
  pwms:
    type: phandle-array
    required: true
    description: |
      Exactly one PWM channel, with its period in nanoseconds and optional
      polarity flags. Use normal polarity for a conventional active-high servo.
      The period must be nonzero and at least max-pulse-us * 1000.
  min-pulse-us:
    type: int
    required: true
    description: Positive minimum pulse width in microseconds, below max-pulse-us.
  center-pulse-us:
    type: int
    required: true
    description: |
      Calibration reference in microseconds, inclusively between the minimum
      and maximum. This is not applied at startup or used in angle conversion.
  max-pulse-us:
    type: int
    required: true
    description: |
      Maximum pulse width in microseconds. Must fit in a uint32_t after
      conversion to nanoseconds and must not exceed the PWM period.
  min-angle-deg:
    type: int
    required: true
    description: Signed minimum angle in degrees, strictly below max-angle-deg.
  max-angle-deg:
    type: int
    required: true
    description: Signed maximum angle in degrees.
```

## lib/arm/Kconfig
```kconfig
config ARM_CONTROL_MATH
	bool "Planar robot arm math"
	help
	  Hardware-independent kinematics, motion, transmission, workspace,
	  continuity, and controller logic for a two-link planar arm.
```

## lib/arm_control/Kconfig
```kconfig
config ROBOT_ARM_CONTROL
	bool "Planar robot arm controller"
	select ARM_CONTROL_MATH
	help
	  Hardware-independent two-joint controller and enable sequencing.
```

## lib/differential_screw/Kconfig
```kconfig
config DIFFERENTIAL_SCREW
	bool "Differential screw wrist control"
	depends on CPP
	help
	  Pure C++17 differential-screw kinematics, PD control, and stall guard.
```

## lib/esp_now_gamepad_bridge/Kconfig
```kconfig
# SPDX-License-Identifier: Apache-2.0
menuconfig ESP_NOW_GAMEPAD_BRIDGE
	bool "ESP-NOW gamepad UART bridge"
	depends on SERIAL && COBS
	depends on SERIAL_SUPPORT_ASYNC || SERIAL_SUPPORT_INTERRUPT
	select UART_USE_RUNTIME_CONFIGURE
	select CRC
	help
	  Receive COBS/CRC-8 gamepad snapshots on one dedicated UART.
	  The application supplies the UART device. No data is transmitted.

if ESP_NOW_GAMEPAD_BRIDGE

choice ESP_NOW_GAMEPAD_BRIDGE_RX_API
	prompt "UART receive API"
	default ESP_NOW_GAMEPAD_BRIDGE_ASYNC if SERIAL_SUPPORT_ASYNC
	default ESP_NOW_GAMEPAD_BRIDGE_INTERRUPT

config ESP_NOW_GAMEPAD_BRIDGE_ASYNC
	bool "Asynchronous UART"
	depends on SERIAL_SUPPORT_ASYNC
	select UART_ASYNC_API

config ESP_NOW_GAMEPAD_BRIDGE_INTERRUPT
	bool "Interrupt-driven UART"
	depends on SERIAL_SUPPORT_INTERRUPT
	select UART_INTERRUPT_DRIVEN
	help
	  Use for controllers without the async API, including RP2350 PL011.

endchoice

config ESP_NOW_GAMEPAD_BRIDGE_TIMEOUT_MS
	int "Gamepad link timeout in milliseconds"
	default 100
	range 20 5000
	help
	  Neutralize state unless a new valid sequence arrives in this interval.
	  Duplicate or malformed frames do not refresh the deadline.

endif # ESP_NOW_GAMEPAD_BRIDGE
```

## tests/apps/gamepad_servo_protocol/testcase.yaml
```yaml
tests:
  apps.gamepad_servo.protocol:
    tags: [can, protocol, servo]
    integration_platforms:
      - native_sim
      - native_sim/native/64
```

## tests/boards/rp2350_can/testcase.yaml
```yaml
# SPDX-License-Identifier: Apache-2.0
common:
  build_only: true
  platform_allow:
    - waveshare_rp2350_can/rp2350a/m33
  integration_platforms:
    - waveshare_rp2350_can/rp2350a/m33
  tags:
    - board
    - can
    - pwm
    - uart
tests:
  boards.rp2350_can: {}
```

## tests/drivers/can/xl2515_safe/testcase.yaml
```yaml
tests:
  drivers.can.xl2515_safe.fault_recovery:
    tags:
      - can
      - drivers
    platform_allow:
      - native_sim
    integration_platforms:
      - native_sim
```

## tests/drivers/servo/pwm/testcase.yaml
```yaml
tests:
  drivers.servo.pwm:
    tags:
      - drivers
      - servo
      - pwm
    integration_platforms:
      - native_sim
      - native_sim/native/64
```

## tests/lib/esp_now_gamepad_bridge/async_faults/testcase.yaml
```yaml
tests:
  lib.esp_now_gamepad_bridge.async_faults:
    tags: [gamepad, uart]
    integration_platforms:
      - native_sim
      - native_sim/native/64
```

## tests/lib/esp_now_gamepad_bridge/protocol/testcase.yaml
```yaml
tests:
  lib.esp_now_gamepad_bridge.protocol:
    tags: [gamepad, uart, protocol]
    integration_platforms:
      - native_sim
      - native_sim/native/64
```
